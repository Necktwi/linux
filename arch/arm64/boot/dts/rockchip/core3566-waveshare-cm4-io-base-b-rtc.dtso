// SPDX-License-Identifier: (GPL-2.0+ OR MIT)
/dts-v1/;
/plugin/;
#include <dt-bindings/gpio/gpio.h>
#include <dt-bindings/pinctrl/rockchip.h>
/ {
  compatible = "luckfox,core3566", "rockchip,rk3566";
  
  // Fragment 0: Enable I2C1 (already enabled in base, but ensure it's okay)
  fragment@0 {
    target = <&i2c1>;
    __overlay__ {
      status = "okay";
      #address-cells = <1>;
      #size-cells = <0>;
      
      // Add PCF85063 RTC at address 0x51
      rtc@51 {
        compatible = "nxp,pcf85063";
        reg = <0x51>;
        status = "okay";
      };
    };
  };
};
